## CMakeLists.txt
```
# SPDX-FileCopyrightText: Copyright The Zephyr Project Contributors
# SPDX-License-Identifier: Apache-2.0

cmake_minimum_required(VERSION 3.28.0)

get_filename_component(hc32_project_root "${CMAKE_CURRENT_LIST_DIR}/../.." ABSOLUTE)
# Keep the selected source visible to the same provenance audit for west and
# project.py builds; do not inherit another checkout from a user cache.
set(ZEPHYR_BASE "${hc32_project_root}" CACHE PATH "Project Zephyr source" FORCE)
set(Zephyr_DIR "${hc32_project_root}/share/zephyr-package/cmake")
set(ZEPHYR_MODULES
  "${hc32_project_root}/modules/hal/cmsis_6"
  "${hc32_project_root}/modules/hal/xhsc"
)

set(SNIPPET cdc-acm-console CACHE STRING "USB console snippet")
find_package(Zephyr REQUIRED)
project(hc32f4a0_usb_stdio)

target_sources(app PRIVATE
  src/main.c
  src/usb_stdio.c
)
```

## sample.yaml
```
# Copyright The Zephyr HC32F4A0 Contributors
# SPDX-License-Identifier: Apache-2.0
sample:
  name: HC32F4A0 USB CDC ACM standard input and output
common:
  tags: [usb, console, libc]
  platform_allow: uyup_rpi_a/hc32f4a0pitb
tests:
  sample.hc32.usb_stdio:
    build_only: true
```

## prj.conf
```kconfig
# Copyright The Zephyr HC32F4A0 Contributors
# SPDX-License-Identifier: Apache-2.0
CONFIG_GPIO=y
CONFIG_PICOLIBC=y
CONFIG_PICOLIBC_IO_FLOAT=y
CONFIG_STDOUT_CONSOLE=y
CONFIG_CONSOLE_SUBSYS=y
CONFIG_CONSOLE_GETCHAR=y
CONFIG_CONSOLE_GETCHAR_BUFSIZE=128
CONFIG_CONSOLE_PUTCHAR_BUFSIZE=0
CONFIG_LOG=n
CONFIG_UDC_DWC2_DMA=n
CONFIG_UDC_DWC2_HIBERNATION=n
CONFIG_UDC_DWC2_STACK_SIZE=1024
CONFIG_UDC_DRIVER_HIGH_SPEED_SUPPORT_ENABLED=n
CONFIG_CDC_ACM_SERIAL_PRODUCT_STRING="UYUP HC32F4A0 USB Console"
CONFIG_MAIN_STACK_SIZE=2048
CONFIG_ASSERT=y
```

## src/main.c
```c
/* Copyright The Zephyr HC32F4A0 Contributors
 * SPDX-License-Identifier: Apache-2.0
 */

#include <ctype.h>
#include <stdio.h>
#include <zephyr/drivers/gpio.h>
#include <zephyr/drivers/uart.h>
#include <zephyr/kernel.h>

#include "usb_stdio.h"

static const struct gpio_dt_spec led = GPIO_DT_SPEC_GET(DT_ALIAS(led0), gpios);
static const struct device *const console = DEVICE_DT_GET(DT_CHOSEN(zephyr_console));

static void heartbeat(struct k_work *work);
K_WORK_DELAYABLE_DEFINE(heartbeat_work, heartbeat);

static void heartbeat(struct k_work *work)
{
	ARG_UNUSED(work);
	(void)gpio_pin_toggle_dt(&led);
	(void)k_work_reschedule(&heartbeat_work, K_MSEC(500));
}

/* Consume the entire line, including malformed or overlong input, so the
 * next scanf does not repeatedly encounter the same invalid character.
 */
static bool finish_line(void)
{
	bool whitespace_only = true;
	int c;

	while ((c = getchar()) != '\n' && c != EOF) {
		if (!isspace((unsigned char)c)) {
			whitespace_only = false;
		}
	}
	return whitespace_only && c != EOF;
}

int main(void)
{
	int ret = usb_stdio_init();

	if (ret != 0) {
		return ret;
	}
	if (gpio_is_ready_dt(&led) && gpio_pin_configure_dt(&led, GPIO_OUTPUT_INACTIVE) == 0) {
		(void)k_work_reschedule(&heartbeat_work, K_NO_WAIT);
	}

	/* Opening USB1 with DTR enables interaction; LED work remains runnable. */
	for (;;) {
		uint32_t dtr = 0;

		(void)uart_line_ctrl_get(console, UART_LINE_CTRL_DTR, &dtr);
		if (dtr != 0) {
			break;
		}
		k_msleep(20);
	}

	printf("USB1 stdio ready: enter an integer, then Enter.\n");
	printf("Maximum 9 characters including sign; terminal local echo required.\n");
	for (;;) {
		int value;
		int count;
		bool valid_tail;

		printf("number> ");
		fflush(stdout);
		/* The width bounds conversion to values representable by int. */
		count = scanf("%9d", &value);
		valid_tail = finish_line();
		if (count == 1 && valid_tail) {
			printf("value=%d, twice=%d\n", value, value * 2);
		} else {
			fprintf(stderr, "Invalid input: one integer, at most 9 characters.\n");
			clearerr(stdin);
			k_msleep(10);
		}
	}
}
```

## src/usb_stdio.c
```c
/* Copyright The Zephyr HC32F4A0 Contributors
 * SPDX-License-Identifier: Apache-2.0
 */

#include <stdbool.h>
#include <stdio.h>
#include <zephyr/console/console.h>
#include <zephyr/sys/util.h>

#include "usb_stdio.h"

static bool previous_cr;

static int stdin_get(FILE *stream)
{
	ARG_UNUSED(stream);

	for (;;) {
		int c = console_getchar();

		if (c < 0) {
			return _FDEV_ERR;
		}
		/* Accept CR, LF and CRLF terminal line endings as one newline. */
		if (previous_cr && c == '\n') {
			previous_cr = false;
			continue;
		}
		previous_cr = (c == '\r');
		return previous_cr ? '\n' : c;
	}
}

int usb_stdio_init(void)
{
	int ret = console_init();

	if (ret != 0) {
		return ret;
	}

	/* Picolibc's public FILE initializer supplies the missing input callback.
	 * stdout/stderr already use Zephyr's CONFIG_STDOUT_CONSOLE routing.
	 * This is application glue, not a portable ISO C or Zephyr console API.
	 */
	*stdin = (FILE)FDEV_SETUP_STREAM(NULL, stdin_get, NULL, _FDEV_SETUP_READ);
	return 0;
}
```

## src/usb_stdio.h
```c
/* Copyright The Zephyr HC32F4A0 Contributors
 * SPDX-License-Identifier: Apache-2.0
 */

#ifndef HC32_USB_STDIO_H_
#define HC32_USB_STDIO_H_

/* Application adapter: call once before using stdin, with Picolibc selected. */
int usb_stdio_init(void);

#endif /* HC32_USB_STDIO_H_ */
```
