## CMakeLists.txt
```
# SPDX-FileCopyrightText: Copyright The Zephyr Project Contributors
# SPDX-License-Identifier: Apache-2.0

cmake_minimum_required(VERSION 3.28.0)

get_filename_component(hc32_project_root "${CMAKE_CURRENT_LIST_DIR}/../.." ABSOLUTE)
# Keep the selected source visible to the same provenance audit for west and
# project.py builds; do not inherit another checkout from a user cache.
set(ZEPHYR_BASE "${hc32_project_root}" CACHE PATH "Project Zephyr source" FORCE)
set(Zephyr_DIR "${hc32_project_root}/share/zephyr-package/cmake")
set(ZEPHYR_MODULES
  "${hc32_project_root}/modules/hal/cmsis_6"
  "${hc32_project_root}/modules/hal/xhsc"
)

set(SNIPPET cdc-acm-console CACHE STRING "USB console snippet")
find_package(Zephyr REQUIRED)
project(hc32f4a0_usb_console)

target_sources(app PRIVATE
  src/main.c
)
```

## sample.yaml
```
# Copyright The Zephyr HC32F4A0 Contributors
# SPDX-License-Identifier: Apache-2.0
sample:
  name: HC32F4A0 native USB CDC ACM log console
common:
  tags: [usb, uart]
  platform_allow: uyup_rpi_a/hc32f4a0pitb
tests:
  sample.hc32.usb_console:
    harness: console
    harness_config:
      type: one_line
      regex:
        - "USB1 CDC ACM heartbeat"
```

## prj.conf
```kconfig
# Copyright The Zephyr HC32F4A0 Contributors
# SPDX-License-Identifier: Apache-2.0
CONFIG_GPIO=y
CONFIG_PRINTK=y
CONFIG_LOG=y
CONFIG_LOG_DEFAULT_LEVEL=3
CONFIG_LOG_BACKEND_UART=y
CONFIG_LOG_BACKEND_SHOW_COLOR=n
CONFIG_UDC_DRIVER_LOG_LEVEL_ERR=y
CONFIG_USBD_LOG_LEVEL_ERR=y
CONFIG_USBD_CDC_ACM_LOG_LEVEL_OFF=y
CONFIG_UDC_DWC2_DMA=n
CONFIG_UDC_DWC2_HIBERNATION=n
CONFIG_UDC_DWC2_STACK_SIZE=1024
CONFIG_UDC_DRIVER_HIGH_SPEED_SUPPORT_ENABLED=n
CONFIG_CDC_ACM_SERIAL_PRODUCT_STRING="UYUP HC32F4A0 USB Console"
CONFIG_MAIN_STACK_SIZE=2048
CONFIG_ASSERT=y
```

## src/main.c
```c
/*
 * Copyright The Zephyr HC32F4A0 Contributors
 * SPDX-License-Identifier: Apache-2.0
 */

#include <zephyr/kernel.h>
#include <zephyr/drivers/gpio.h>
#include <zephyr/drivers/uart.h>
#include <zephyr/logging/log.h>
#include <zephyr/sys/printk.h>

LOG_MODULE_REGISTER(hc32_usb_console, LOG_LEVEL_INF);

static const struct gpio_dt_spec led = GPIO_DT_SPEC_GET(DT_ALIAS(led0), gpios);
static const struct device *const console = DEVICE_DT_GET(DT_CHOSEN(zephyr_console));

int main(void)
{
	uint32_t sequence = 0;
	int64_t next_heartbeat = 0;
	bool led_ready = gpio_is_ready_dt(&led);

	if (!device_is_ready(console)) {
		return -ENODEV;
	}
	if (led_ready && gpio_pin_configure_dt(&led, GPIO_OUTPUT_INACTIVE) != 0) {
		led_ready = false;
	}

	/* USB is initialized by Zephyr's cdc-acm-console snippet. Do not block
	 * board execution waiting for a host to open the COM port.
	 */
	for (;;) {
		uint32_t dtr = 0;
		unsigned char c;

		(void)uart_line_ctrl_get(console, UART_LINE_CTRL_DTR, &dtr);
		if (k_uptime_get() >= next_heartbeat) {
			if (led_ready) {
				(void)gpio_pin_toggle_dt(&led);
			}
			if (dtr != 0) {
				LOG_INF("USB1 CDC ACM heartbeat %u, uptime %lld ms", sequence,
					(long long)k_uptime_get());
			}
			sequence++;
			next_heartbeat = k_uptime_get() + 1000;
		}
		/* Echo host input to exercise both OUT and IN endpoints. */
		while (dtr != 0 && uart_poll_in(console, &c) == 0) {
			uart_poll_out(console, c);
		}
		k_msleep(10);
	}
}
```
