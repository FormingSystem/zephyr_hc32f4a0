## Kconfig
```kconfig
# SPDX-FileCopyrightText: Copyright The Zephyr Project Contributors
# SPDX-License-Identifier: Apache-2.0

menuconfig HC32F4A0_PORT_MODULE
	bool "HC32F4A0 port module"
	help
	  Enable the external HC32F4A0 port integration. This option exposes
	  module components; it does not enable an HC32 SoC or board target.

if HC32F4A0_PORT_MODULE

rsource "drivers/Kconfig"

endif
```

## boards/uyup/uyup_rpi_a/uyup_rpi_a_hc32f4a0pitb_defconfig
```kconfig
# Copyright The zephyr_hc32f4a0 Contributors
# SPDX-License-Identifier: Apache-2.0

CONFIG_SERIAL=y
CONFIG_CONSOLE=y
CONFIG_UART_CONSOLE=y
CONFIG_GPIO=y
```

## drivers/gpio/Kconfig.hc32
```kconfig
# SPDX-FileCopyrightText: Copyright The Zephyr Project Contributors
# SPDX-License-Identifier: Apache-2.0

config GPIO_HC32
	bool "HC32F4A0 GPIO driver"
	default y
	depends on SOC_HC32F4A0PITB
	depends on DT_HAS_XHSC_HC32_GPIO_ENABLED
	help
	  Enable digital input, push-pull and open-drain output on the package's
	  available GPIO pins. Pull-down and GPIO interrupts are not supported.
```

## drivers/hwinfo/Kconfig.hc32
```kconfig
# Copyright The Zephyr HC32F4A0 Contributors
# SPDX-License-Identifier: Apache-2.0

config HWINFO_HC32
	bool "HC32F4A0 device identifier"
	default y
	depends on SOC_SERIES_HC32F4A0
	select HWINFO_HAS_DRIVER
	help
	  Read the 96-bit factory identifier from the EFM unique-ID registers.
	  Reset-cause operations are not implemented by this driver.
```

## dts/bindings/gpio/xhsc,hc32-gpio.yaml
```yaml
# Copyright The zephyr_hc32f4a0 Contributors
# SPDX-License-Identifier: Apache-2.0

description: Xiaohua HC32 GPIO port

compatible: "xhsc,hc32-gpio"

include: [gpio-controller.yaml, base.yaml]

properties:
  reg:
    required: true

  port-index:
    type: int
    required: true
    enum: [0, 1, 2, 3, 4, 5, 6, 7, 8]
    description: GPIO port number, where zero is port A and eight is port I.

  ngpios:
    const: 16

  "#gpio-cells":
    const: 2

gpio-cells:
  - pin
  - flags
```

## dts/bindings/usb/xhsc,hc32f4a0-fsotg.yaml
```yaml
# Copyright The Zephyr HC32F4A0 Contributors
# SPDX-License-Identifier: Apache-2.0

description: HC32F4A0 USBFS controller with its internal full-speed PHY

compatible: "xhsc,hc32f4a0-fsotg"

include: snps,dwc2.yaml

properties:
  interrupt-source:
    type: int
    required: true
    const: 399
    description: USBFS global interrupt source selected by the HC32 INTC.

  disable-vbus-sensing:
    type: boolean
    description: |
      Override the VBUS-valid input when the board does not connect PA9 to
      USB VBUS. Software treats the bus as powered while the controller is
      enabled. Physical VBUS removal detection is unavailable in this mode.
```

## learning/P01_zephyr_make_project/labs/p006/components/app_greeting/Kconfig
```kconfig
# SPDX-License-Identifier: Apache-2.0
config APP_GREETING
    bool "Application greeting component"
    default n
    help
      Build the reusable greeting function for this application.
```

## learning/board/labs/hc32_port/Kconfig
```kconfig
# SPDX-License-Identifier: Apache-2.0
if GPIO
rsource "drivers/gpio/Kconfig.hc32"
endif
if SERIAL
rsource "drivers/serial/Kconfig.hc32"
endif
```

## learning/board/labs/hc32_port/boards/uyup/uyup_rpi_a/Kconfig.uyup_rpi_a
```kconfig
# Copyright The zephyr_hc32f4a0 Contributors
# SPDX-License-Identifier: Apache-2.0

config BOARD_UYUP_RPI_A
	select SOC_HC32F4A0PITB
```

## learning/board/labs/hc32_port/boards/uyup/uyup_rpi_a/board.yml
```yaml
# Copyright The zephyr_hc32f4a0 Contributors
# SPDX-License-Identifier: Apache-2.0

board:
  name: uyup_rpi_a
  full_name: UYUP-RPI-A-2.5 HC32F4A0PITB
  vendor: uyup
  socs:
    - name: hc32f4a0pitb
```

## learning/board/labs/hc32_port/drivers/serial/Kconfig.hc32
```kconfig
# SPDX-FileCopyrightText: Copyright The Zephyr Project Contributors
# SPDX-License-Identifier: Apache-2.0

config UART_HC32
	bool "HC32F4A0 polling UART driver"
	default y
	depends on SOC_HC32F4A0PITB
	depends on DT_HAS_XHSC_HC32_UART_ENABLED
	select SERIAL_HAS_DRIVER
	help
	  Enable polling USART1 on PA9 and PA10. Interrupt-driven, asynchronous
	  and runtime configuration APIs are not implemented.
```

## learning/board/labs/hc32_port/dts/bindings/serial/xhsc,hc32-uart.yaml
```yaml
# Copyright The zephyr_hc32f4a0 Contributors
# SPDX-License-Identifier: Apache-2.0

description: |
  Xiaohua HC32 UART in asynchronous mode. The initial implementation supports
  USART1 polling with the TX/RX pin functions selected by the SoC driver.

compatible: "xhsc,hc32-uart"

include: uart-controller.yaml

properties:
  reg:
    required: true

  current-speed:
    required: true

  tx-port:
    type: phandle
    required: true
    description: HC32 GPIO controller providing the transmit pin.

  rx-port:
    type: phandle
    required: true
    description: HC32 GPIO controller providing the receive pin.

  tx-pin:
    type: int
    required: true
    enum: [0, 1, 2, 3, 4, 5, 6, 7, 8, 9, 10, 11, 12, 13, 14, 15]
    description: Transmit pin number within tx-port.

  rx-pin:
    type: int
    required: true
    enum: [0, 1, 2, 3, 4, 5, 6, 7, 8, 9, 10, 11, 12, 13, 14, 15]
    description: Receive pin number within rx-port.

  parity:
    const: "none"

  stop-bits:
    default: "1"
    const: "1"

  data-bits:
    default: 8
    const: 8
```

## learning/board/labs/hc32_port/soc/xhsc/hc32f4a0/Kconfig.soc
```kconfig
# SPDX-FileCopyrightText: Copyright The Zephyr HC32F4A0 Contributors
# SPDX-License-Identifier: Apache-2.0

config SOC_FAMILY_XHSC
	bool

config SOC_FAMILY
	default "xhsc" if SOC_FAMILY_XHSC

config SOC_SERIES_HC32F4A0
	bool
	select SOC_FAMILY_XHSC

config SOC_SERIES
	default "hc32f4a0" if SOC_SERIES_HC32F4A0

config SOC_HC32F4A0PITB
	bool
	select SOC_SERIES_HC32F4A0

config SOC
	default "hc32f4a0pitb" if SOC_HC32F4A0PITB
```

## learning/cmake/labs/zephyr_module/Kconfig
```kconfig
# SPDX-License-Identifier: Apache-2.0
config LEARNING_SCALE
    bool "Enable the learning scale module"
    default y
    help
      Compile the small demonstration module and expose its header.
```

## soc/xhsc/hc32f4a0/Kconfig
```kconfig
# SPDX-FileCopyrightText: Copyright The Zephyr HC32F4A0 Contributors
# SPDX-License-Identifier: Apache-2.0

config SOC_HC32F4A0PITB
	select ARM
	select CPU_CORTEX_M4
	select CPU_HAS_FPU
	select CPU_HAS_ARM_MPU
	select CPU_CORTEX_M_HAS_SYSTICK
	select CPU_CORTEX_M_HAS_VTOR
	select SOC_RESET_HOOK
	select SOC_EARLY_INIT_HOOK
	select CMSIS_CORE_HAS_SYSTEM_CORE_CLOCK
	select BUILD_OUTPUT_HEX
```
